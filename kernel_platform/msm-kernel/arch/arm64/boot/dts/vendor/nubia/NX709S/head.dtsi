/*
 * nubia overwrite dts
 */

#include "others.dtsi"
//#include "haptic.dtsi"
#include "vibrator_double.dtsi"
//#include "sensors.dtsi"
#include "soc_fan.dtsi"
#include "aw22xxx.dtsi"
#include "aw.dtsi"
#include "nfc.dtsi"
//#include "usb.dtsi"
#include "tp.dtsi"
#include "pa.dtsi"
/*#include "ese.dtsi"*/
