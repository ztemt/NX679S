## kernel_platform/msm-kernel/drivers/fan/Kconfig
```kconfig
#
# Fan driver configuration
#
menuconfig NUBIA_FAN
	bool "Fan"
	default n
	help
	  Say Y here if you have a Fan connected
	  to your system.


config FAN_CORE
	tristate "Fan core"
	default n

config FAN_REMOVE_FOR_GKI
      bool "Fan gki"
      default n

config FAN_REMOVE_RPM_CORRECT
       bool "Fan no rpm correct"
        default n
        help
          Say Y here if you have a Fan rpm correct
          to your system.

config SOC_FAN
        tristate "Soc Fan"
        default n
       help
          Say Y here if you use soc control fan.

#config FAN_UPDATA
#	bool "Fan updata"
#	default n
```

## kernel_platform/msm-kernel/drivers/leds/nubia_led/Kconfig
```kconfig
#
# nubia led driver configuration
#

config NUBIG_HAPTIC_GKI
    bool "Haptic driver for awinic aw8697 for gki"
    default n
    help
      nubia aw8697 for GKI test.

menuconfig NUBIA_LED
	tristate "nubia led driver"
	default n
	help
	  Say Y here if you have a nubia led connected
	  to your system.

	  If unsure, say N.

if NUBIA_LED

source "drivers/leds/nubia_led/aw22xxx/Kconfig"
source "drivers/leds/nubia_led/aw86927/Kconfig"
source "drivers/leds/nubia_led/aw86927_double/Kconfig"
#source "drivers/leds/nubia_led/aw8697/Kconfig"
source "drivers/leds/nubia_led/aw96205/Kconfig"
endif
```

## kernel_platform/msm-kernel/drivers/leds/nubia_led/aw86927_double/Kconfig
```kconfig
#
# Qcom AWINIC_HAPTIC_HV_DOUBLE Driver
#

config AWINIC_HAPTIC_HV_DOUBLE
	tristate "AWINIC_HAPTIC_HV_DOUBLE driver"
	depends on I2C
	help
	  Say Y here if you have Awinic AW869X/AW869XX haptic controller
	  chip in your system.
	  If unsure, say N.
	  To compile this driver as a module, choose M here: the
	  module will be called awinic_haptic_hv.
```

## kernel_platform/msm-kernel/drivers/leds/nubia_led/aw8695/Kconfig
```kconfig
#
# nubia led AW8695 driver configuration
#
config AW8695_HAPTIC
    tristate "Haptic driver for awinic AW8695 series"
    depends on I2C
    default n
    help
      This option enables support for AW8695 series Haptic Driver.
```

## kernel_platform/msm-kernel/drivers/leds/nubia_led/aw8697/Kconfig
```kconfig
config AW8697_HAPTIC
    tristate "Haptic driver for awinic aw8697 series"
    depends on I2C
    help
      This option enables support for aw8697 series Haptic Driver.
#config NUBIG_HAPTIC_GKI
#    bool "Haptic driver for awinic aw8697 for gki"
#    default n
#    help
#      nubia aw8697 for GKI test.
```

## kernel_platform/msm-kernel/drivers/nfc/samsung/Kconfig
```kconfig
#
# Near Field Communication (NFC) devices
#

menu "Near Field Communication (NFC) devices"

config SEC_NFC
	tristate "Samsung NFC driver"
	default n
	help
	  SAMSUNG NFC Driver.
	  This driver provides support for SAMSUNG NFC products.
	  You should select your NFC product and interface.

	  Say Y here to compile support for SAMSUNG NFC driver into the
	  kernel.

config SEC_NFC_PRODUCT_N3
		bool "RN3"
config SEC_NFC_PRODUCT_N5
		bool "RN5/RNx"
config SEC_NFC_IF_UART
		bool "UART"
config SEC_NFC_IF_I2C
		bool "I2C"
config SEC_NFC_IF_I2C_GPIO
		bool "I2C-GPIO (S/W-I2C)"
		select I2C_CHARDEV
		select I2C_MUX
		select I2C_MUX_GPIO
		select I2C_ARB_GPIO_CHALLENGE
		select I2C_ALGOBIT
		select I2C_GPIO
config SEC_NFC_GPIO_CLK
		bool "SEC NFC GPIO CLK"
		default n
		help
		  SAMSUNG NFC CLR REQ feature.
		  This feature provides support for SAMSUNG NFC products.
		  You should select this feature if your NFC product uses AP CLK.

		  Say Y here to compile support for SAMSUNG NFC CLK REQ feature into the
		  kernel.
config SEC_NFC_DEDICATED_CLK
		bool "SEC NFC DEDICATED CLK"
			default n
config SEC_NFC_LDO_EN
		bool "SEC NFC LDO"
			default n
config SEC_NFC_PMIC_LDO
		bool "SEC NFC PMIC LDO"
			default n
config SEC_ESE_COLDRESET
		bool "eSE Cold reset"
			default n
endmenu
```

## kernel_platform/msm-kernel/drivers/nubia/Kconfig
```kconfig
#
# Nubia drivers configuration
#

#menuconfig NUBIA_DRIVERS
menu "nubia drivers"

config NUBIA_DRIVERS
	tristate "NUBIA DRIVERS"
	default n
	help
	  Say Y here if you want to enable NUBIA DRIVERS
	  If unsure, say N.

comment "Nubia Device Drivers"

if NUBIA_DRIVERS

config NUBIA_FINGERPRINT
        tristate "NUBIA_FINGERPRINT"
        default n
        help
         Say Y here if you have enable NUBIA_FINGERPRINT
         IF  unsure ,say N

config NUBIA_SENSORS
        bool "NUBIA_SENSORS"
        default n
        help
         Say Y here if you have enable NUBIA_SENSORS
         IF  unsure ,say N

config NUBIA_SENSORS_SENS
        bool "NUBIA_SENSORS_SENS"
        default n
        help
         Say Y here if you have enable NUBIA_SENSORS_SENS
         IF  unsure ,say N

config NUBIA_SCHED_CTL
    tristate "NUBIA_SCHED_CTL"
    default m 
    help
     Say Y here if you have enable NUBIA_SCHED_CTL
     IF  unsure ,say N

config NUBIA_FORK_MONITOR_CTL
        tristate "NUBIA_FORK_MONITOR_CTL"
        default m 
        help
         Say Y here if you have enable FORK_MONITOR_CTL 
         IF  unsure ,say N

endif

if NUBIA_FINGERPRINT
source "drivers/nubia/fingerprint/Kconfig"
endif
if NUBIA_SENSORS_SENS
source "drivers/nubia/sensors_sensitivity/Kconfig"
endif
if NUBIA_SENSORS
source "drivers/nubia/stk3337/Kconfig"
endif
source "drivers/nubia/freezer/Kconfig"
source "drivers/nubia/nblog/Kconfig"
endmenu
```

## kernel_platform/msm-kernel/drivers/nubia/fingerprint/Kconfig
```kconfig
################################################## FINGER_PRINTER START

######## Add for goodix fingerprint Start ########
config NUBIA_FP_GOODIX
	tristate "generic goodix fingerprint driver"
	default n
	help
	add support for goodix fingerprint driver.

config NUBIA_FP_GOODIX_GKI
	tristate "generic goodix fingerprint driver gki build"
	default n
	help
	add support for goodix fingerprint driver gki build.

if NUBIA_FP_GOODIX
source "drivers/nubia/fingerprint/goodix/Kconfig"
endif
######## Add for goodix fingerprint End   ########

################################################## FINGER_PRINTER END
```

## kernel_platform/msm-kernel/drivers/nubia/fingerprint/goodix/Kconfig
```kconfig
config NUBIA_FP_GOODIX_GW9668
	tristate "generic goodix GW9668 driver"
	default n
	help
	add support for goodix GW9668 driver.
```

## kernel_platform/msm-kernel/drivers/nubia/freezer/Kconfig
```kconfig
config NUBIA_CGROUP_FREEZER_V2
	tristate "NUBIA_FREEZER_V2"
        default m
	help
	  Allow to specify the low level IRQ handler at run time.
```

## kernel_platform/msm-kernel/drivers/nubia/nblog/Kconfig
```kconfig
#
# ZTE SoC drivers
#

config NBLOG
	tristate "NUBIA LOG MODULES"
	default y
	help
	  this function for big data; these logs are send to data service, and then to analyze.
```

## kernel_platform/msm-kernel/drivers/nubia/stk3337/Kconfig
```kconfig
################################################ SENROS DRIVER


config NUBIA_SENSORS_STK3337
	tristate "support proximity/light driver"
	depends on NUBIA_SENSORS
	default n
	help
		nubia device of ambient&&prox

config FEATURE_NUBIA_SENSORS_LOG_ON
	tristate "NUBIA SENSORS LOG ON"
	depends on NUBIA_SENSORS
	default n
	help
		If you want to enable the sensor log,
		
config SENSOR_STK_GKI
	tristate "support proximity/light driver gki"
	depends on NUBIA_SENSORS
	default n
	help
		nubia device of ambient&&prox for gki
```
